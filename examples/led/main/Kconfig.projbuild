## examples/led/main/Kconfig.projbuild
```kconfig
menu "LED Matter Example Configuration"

config EXAMPLE_LED_GPIO
    int "LED GPIO"
    range 0 48
    default 8
    help
        GPIO used for the Matter On/Off LED accessory.

config EXAMPLE_LED_ACTIVE_LOW
    bool "LED is active-low"
    default n
    help
        Enable if your LED turns on when the GPIO output is low.

endmenu
```

## examples/led/sdkconfig.defaults
```kconfig
CONFIG_IDF_TARGET="esp32c6"
CONFIG_ESPTOOLPY_FLASHSIZE_4MB=y
CONFIG_PARTITION_TABLE_SINGLE_APP=y
CONFIG_ESP_CONSOLE_UART_DEFAULT=y
CONFIG_OPENTHREAD_ENABLED=y
CONFIG_OPENTHREAD_FTD=y
CONFIG_OPENTHREAD_CLI=n
CONFIG_CHIP_ENABLE_OPENTHREAD=y
CONFIG_EXAMPLE_LED_GPIO=8
CONFIG_EXAMPLE_LED_ACTIVE_LOW=n
```
